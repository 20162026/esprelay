## app/main/Kconfig.projbuild
```kconfig
menu "ADDITIONAL Configuration"

config ROUTER_SSID
    string "Router SSID"
        help
            Router SSID.

config ROUTER_PASSWORD
    string "Router password"
        help
            Router password.

config MESH_ID
    string "Mesh ID"
        default "12345678"
        help
            Mesh network identification, Nodes with the same mesh ID can
            communicate with each other.

config MESH_PASSWORD
    string "Mesh Password"
    default "MESHPASSWORD"
    help
        Mesh AP password. Password length must be 8 bits smaller than 64 bits,Set to null to not encrypt

config MQTT_URL
    string "MQTT broker URL"
    default "mqtt://192.168.8.200"
    help
        URL of the broker to connect to

endmenu
```
